## Config.in
```kconfig
config BR2_PACKAGE_FLASHINGLED_DRIVER
    bool "FlashingLed"
            help
                Pilote d'une led à 4 pins, la faisant clignoter à activation (1), l'éteignant à désactivation (0)
```
